/ {
    leds {
        // Add LED on PF1/D8
        external_led: ext_led {
            gpios = <&gpiof 1 GPIO_ACTIVE_HIGH>;
            label = "EXT LD";
        };
    };
    aliases {
        led0 = &green_led_3;
        led1 = &external_led;
    };
};