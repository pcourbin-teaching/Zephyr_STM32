## Samples/zephyr/boards/stm32f429i_disc1.conf
```kconfig
# Activate config to use the ILI9341 display with SPI interface
CONFIG_ILI9341=y

# Activate config to use the BME680 on I2C interface
CONFIG_I2C=y
```

## WithGUI/zephyr/boards/stm32f429i_disc1.conf
```kconfig
# Activate config to use the ILI9340 display with SPI interface
CONFIG_ILI9340=y

CONFIG_LV_COLOR_16_SWAP=y

# Activate config to use the BME680 on I2C interface
CONFIG_I2C=y
```

## Zephyr_WithGUI_WithBME/zephyr/boards/stm32f429i_disc1.conf
```kconfig
# Activate config to use the ILI9340 display with SPI interface
CONFIG_SPI=y
CONFIG_ILI9340=y

#CONFIG_KSCAN=y
#CONFIG_LVGL_POINTER_KSCAN=y
CONFIG_LVGL_HOR_RES_MAX=240
CONFIG_LVGL_VER_RES_MAX=320
CONFIG_LVGL_DPI=100
CONFIG_LVGL_COLOR_16_SWAP=y
CONFIG_LVGL_COLOR_DEPTH_16=y

# Activate config to use the BME680 on I2C interface
CONFIG_I2C=y
```

## zephyr/boards/stm32f429i_disc1.conf
```kconfig
# Activate config to use the ILI9340 display with SPI interface
CONFIG_SPI=y
CONFIG_ILI9340=y

#CONFIG_KSCAN=y
#CONFIG_LVGL_POINTER_KSCAN=y
CONFIG_LVGL_HOR_RES_MAX=240
CONFIG_LVGL_VER_RES_MAX=320
CONFIG_LVGL_DPI=100

CONFIG_I2C=y
```
