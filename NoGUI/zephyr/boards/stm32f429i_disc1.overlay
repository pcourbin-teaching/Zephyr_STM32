/ {
    leds {
        // Add LED on PG5
        external_led: ext_led {
            gpios = <&gpiog 5 GPIO_ACTIVE_HIGH>;
            label = "EXT LD";
        };
    };
    aliases {
        led0 = &green_led_3;
        led1 = &red_led_4;
        led2 = &external_led;
        sw0 = &user_button;
    };
};